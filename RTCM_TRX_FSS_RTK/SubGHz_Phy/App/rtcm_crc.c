
#include "rtcm_crc.h"

/* checksum lookup table -----------------------------------------------------*/
static const uint32_t tbl_CRC16[256] = {
  0x0000, 0x1021, 0x2042, 0x3063, 0x4084, 0x50a5, 0x60c6, 0x70e7,
  0x8108, 0x9129, 0xa14a, 0xb16b, 0xc18c, 0xd1ad, 0xe1ce, 0xf1ef,
  0x1231, 0x0210, 0x3273, 0x2252, 0x52b5, 0x4294, 0x72f7, 0x62d6,
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  0x6e17, 0x7e36, 0x4e55, 0x5e74, 0x2e93, 0x3eb2, 0x0ed1, 0x1ef0};

static const unsigned int tbl_CRC24[] = {
	0x000000,0x864CFB,0x8AD50D,0x0C99F6,0x93E6E1,0x15AA1A,0x1933EC,0x9F7F17,
	0xA18139,0x27CDC2,0x2B5434,0xAD18CF,0x3267D8,0xB42B23,0xB8B2D5,0x3EFE2E,
	0xC54E89,0x430272,0x4F9B84,0xC9D77F,0x56A868,0xD0E493,0xDC7D65,0x5A319E,
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	0x42FA2F,0xC4B6D4,0xC82F22,0x4E63D9,0xD11CCE,0x575035,0x5BC9C3,0xDD8538
};

static const uint32_t tbl_CRC32[ 256 ] =
{
0x00000000L, 0x77073096L, 0xee0e612cL, 0x990951baL, 0x076dc419L, 0x706af48fL, 0xe963a535L, 0x9e6495a3L,
0x0edb8832L, 0x79dcb8a4L, 0xe0d5e91eL, 0x97d2d988L, 0x09b64c2bL, 0x7eb17cbdL, 0xe7b82d07L, 0x90bf1d91L,
0x1db71064L, 0x6ab020f2L, 0xf3b97148L, 0x84be41deL, 0x1adad47dL, 0x6ddde4ebL, 0xf4d4b551L, 0x83d385c7L,
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0xb3667a2eL, 0xc4614ab8L, 0x5d681b02L, 0x2a6f2b94L, 0xb40bbe37L, 0xc30c8ea1L, 0x5a05df1bL, 0x2d02ef8dL
};

#define POLYCRC32   0xEDB88320u /* CRC32 polynomial */

uint16_t rtk_crc16_1d0f(const uint8_t* buff, int32_t len)
{
	uint32_t i;
    uint16_t crc = 0x1D0F;

    for (i=0; i<len; i++) {
        crc = (crc << 8) ^ tbl_CRC16[ (crc >> 8) ^ buff[i] ];
    }

    return crc;
}


/* SBF checksum calculation --------------------------------------------------*/
uint16_t rtk_crc16(const uint8_t* buff, int32_t len)
{
	uint32_t i;
	uint16_t crc = 0;

    for (i=0; i<len; i++) {
        crc = (crc << 8) ^ tbl_CRC16[ (crc >> 8) ^ buff[i] ];
    }

    return crc;
}

uint32_t rtk_crc24q(const uint8_t *buff, int32_t len)
{
	uint32_t crc = 0;
    int32_t i;

    for (i = 0; i < len; i++) {
        crc = ((crc << 8) & 0xFFFFFF) ^ tbl_CRC24[(crc >> 16) ^ buff[i]];
    }

    return crc;
}

/* crc-32 parity ---------------------------------------------------------------
* compute crc-32 parity for novatel raw
* args   : unsigned char *buff I data
*          int    len    I      data length (bytes)
* return : crc-32 parity
* notes  : see NovAtel OEMV firmware manual 1.7 32-bit CRC
*
* How to generate the CRC32 static table "tbl_CRC32" ?
*
* Generate tool:
*   qxwz_void_t qxwz_crc32_build(void)
*   {
*       qxwz_s32_t i, j;
*       qxwz_u32_t crc = 0;
*
*       for ( i = 0; i <= 255 ; i++ ){
*           crc = i;
*
*           for ( j = 8 ; j > 0; j-- ){
*               if ( crc & 1 )
*                   crc = ( crc >> 1 ) ^ POLYCRC32;
*               else
*                   crc >>= 1;
*           }
*
*           tbl_CRC32[ i ] = crc;
*       }
*   }
*-----------------------------------------------------------------------------*/
/*-crc32 dynamically--*/
uint32_t rtk_crc32d(const uint8_t *buff, int32_t len)
{
	uint32_t crc=0;
    int32_t  i,j;

    for (i=0;i<len;i++) {
        crc^=buff[i];

        for (j=0;j<8;j++) {
            if (crc&1) crc=(crc>>1)^POLYCRC32; else crc>>=1;
        }
    }

    return crc;
}
/*-crc32 via table--*/
uint32_t rtk_crc32(const uint8_t *buff, int32_t len)
{
	uint32_t crc1, crc2, crc =0;
	int32_t i  = 0;

    for (i = 0; i < len; i++) {
        crc1 = ( crc >> 8 ) & 0x00FFFFFFL;
        crc2 = tbl_CRC32[ ( (int32_t) crc ^ buff[i] ) & 0xff ];
        crc = crc1 ^ crc2;
    }

    return crc;
}

uint32_t rtk_crc32_acc(uint32_t pcrc, const uint8_t  *buff, int32_t len)
{
	uint32_t crc1, crc2, crc;
	int32_t i = 0;

	crc = pcrc ^ 0xffffffffL;

	for (i = 0; i < len; i++) {
		crc1 = crc >> 8;
		crc2 = tbl_CRC32[((int32_t)crc ^ buff[i]) & 0xff];
		crc = crc1 ^ crc2;
	}

	return (crc ^ 0xffffffffL);
}
